## config/west.yml
```yaml
manifest:
  remotes:
    - name: zmkfirmware
      url-base: https://github.com/zmkfirmware
    - name: nice-keyboards
      url-base: https://github.com/nice-keyboards
    - name: urob
      url-base: https://github.com/urob
  projects:
    - name: zmk
      remote: zmkfirmware
      revision: main
      import: app/west.yml
    - name: nice-boards
      remote: nice-keyboards
      revision: main
    - name: zmk-helpers
      remote: urob
      revision: main
  self:
    path: config
```
